## main/Kconfig.projbuild
```kconfig
menu "Example Configuration"

    choice
        prompt "Select the example to build"
        default EXAMPLE_BUILD_GENERAL_TEST
        config EXAMPLE_BUILD_SCREEN
            bool "screen"
        config EXAMPLE_BUILD_SCREEN_LVGL
            bool "screen_lvgl"
        config EXAMPLE_BUILD_SCREEN_LVGL_TOUCH_DRAW
            bool "screen_lvgl_touch_draw"
        config EXAMPLE_BUILD_SD
            bool "sd"
        config EXAMPLE_BUILD_RS485_CAN
            bool "rs485_can"
        config EXAMPLE_BUILD_GENERAL_TEST
            bool "general_test"
    endchoice

endmenu
```

## sdkconfig.defaults
```kconfig
CONFIG_IDF_TARGET="esp32s3"
CONFIG_ESPTOOLPY_FLASHMODE_QIO=y
CONFIG_ESPTOOLPY_FLASHSIZE_16MB=y
CONFIG_PARTITION_TABLE_CUSTOM=y
CONFIG_PARTITION_TABLE_CUSTOM_FILENAME="partitions.csv"

CONFIG_SPIRAM=y
CONFIG_SPIRAM_MODE_QUAD=y
CONFIG_SPIRAM_SPEED_80M=y
CONFIG_SPIRAM_XIP_FROM_PSRAM=y
CONFIG_SPIRAM_FETCH_INSTRUCTIONS=y
CONFIG_SPIRAM_RODATA=y
CONFIG_ESP32S3_DATA_CACHE_LINE_64B=y
CONFIG_ESP_DEFAULT_CPU_FREQ_MHZ_240=y
CONFIG_COMPILER_OPTIMIZATION_PERF=y
CONFIG_ESP_MAIN_TASK_STACK_SIZE=8192

CONFIG_FREERTOS_HZ=1000

CONFIG_LV_USE_SYSMON=y
CONFIG_LV_USE_PERF_MONITOR=y
CONFIG_LV_PERF_MONITOR_ALIGN_BOTTOM_RIGHT=y
CONFIG_LV_USE_CLIB_MALLOC=y
CONFIG_LV_DEF_REFR_PERIOD=10
CONFIG_LV_FONT_MONTSERRAT_20=y
```
